## Documentation/devicetree/bindings/mux/sophgo,cv1800b-aiao-mux.yaml
```yaml
# SPDX-License-Identifier: (GPL-2.0-only OR BSD-2-Clause)
%YAML 1.2
---
$id: http://devicetree.org/schemas/mux/sophgo,cv1800b-aiao-mux.yaml#
$schema: http://devicetree.org/meta-schemas/core.yaml#

title: Sophgo CV1800B/SG2002 AIAO audio mux controller

maintainers:
  - Anton D. Stavinskii <stavinsky@gmail.com>

description: |
  Audio routing mux inside the AIAO block on Sophgo SG2002/CV1800B.

allOf:
  - $ref: mux-controller.yaml#

properties:
  compatible:
    enum:
      - sophgo,cv1800b-aiao-mux
  reg:
    maxItems: 1
  "#mux-state-cells":
    const: 2

required:
  - compatible
  - reg
  - "#mux-state-cells"

additionalProperties: false

examples:
  - |
    aiao_mux: mux-controller@4108000 {
      compatible = "sophgo,cv1800b-aiao-mux";
      reg = <0x04108000 0x1000>;
      #mux-state-cells = <2>;
    };
```

## sound/soc/sophgo/Kconfig
```kconfig
menu "Sophgo"
	depends on COMPILE_TEST || ARCH_SOPHGO

config SND_SOC_CV1800B_TDM
	tristate "Sophgo CV1800B I2S/TDM support"
	depends on SND_SOC && OF
	select SND_SOC_GENERIC_DMAENGINE_PCM
	help
	  This option enables the I2S/TDM audio controller found in Sophgo
	  CV1800B / SG2002 SoCs. The controller supports standard I2S
	  audio modes for playback and capture.

	  The driver integrates with the ASoC framework and uses the DMA
	  engine for audio data transfer. It is intended to be configured
	  via Device Tree along with simple-audio-card module.

	  To compile the driver as a module, choose M here: the module will
	  be called cv1800b_tdm.

config SND_SOC_CV1800B_SOUND_CARD
	tristate "Sophgo CV1800B sound card"
	depends on SND_SOC && OF
	help
	  Basic ASoC machine driver for Sophgo CV1800B SoCs.

	  This driver provides a simple sound card glue layer that connects
	  CV1800B I2S/TDM controllers to codecs described in Device Tree.
	  Only the I2S audio format is supported.

	  To compile the driver as a module, choose M here:
	  The module will be called cv1800b_sound_card.

config SND_SOC_CV1800B_ADC_CODEC
	tristate "Sophgo CV1800B/SG2002 internal ADC codec"
	depends on SND_SOC
	help
	  Say Y or M to build support for the Sophgo CV1800B
	  internal analog ADC codec block (RXADC).

	  This driver provides an ASoC codec DAI for capture and basic
	  control of the RXADC registers.

endmenu
```
